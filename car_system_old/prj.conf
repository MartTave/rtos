## CMakeLists.txt
```
cmake_minimum_required(VERSION 3.20.0)
find_package(Zephyr REQUIRED HINTS $ENV{ZEPHYR_BASE})

project(
    CarSystem
    VERSION 0.1
    DESCRIPTION "CPP Car system application."
    LANGUAGES C CXX
)

target_sources(
    app
    PRIVATE
    src/main.cpp
    src/car_system.cpp
    src/sporadic_task_generator.cpp
    src/deferrable_server.cpp
)
```

## Kconfig
```
menu "Zephyr"
source "Kconfig.zephyr"
endmenu

module = APP
module-str = APP
source "subsys/logging/Kconfig.template.log_config"

config PHASE_B
    bool "Enable Phase B - Aperiodic Tasks"
    default n
    help
      Enable Phase B which adds aperiodic tasks (Presence Detection and
      Search for Peripheral Devices)
```

## prj.conf
```kconfig
# C++ support
CONFIG_CPP=y
CONFIG_REQUIRES_FULL_LIBCPP=y
CONFIG_STD_CPP17=y
# use zpp_lib
CONFIG_USE_ZPP_LIB=y

# Phase B - Aperiodic tasks
CONFIG_PHASE_B=y

# Logging disabled for performance
CONFIG_LOG=n
CONFIG_BOOT_BANNER=n

# Thread configuration
CONFIG_ZPP_THREAD_POOL_SIZE=8
CONFIG_MAIN_STACK_SIZE=4096
CONFIG_TIMESLICING=n
CONFIG_THREAD_NAME=y

# SEGGER SystemView (for nRF board)
CONFIG_TRACING=y
CONFIG_SEGGER_SYSTEMVIEW=y
CONFIG_SEGGER_SYSTEMVIEW_BOOT_ENABLE=y
CONFIG_SEGGER_SYSVIEW_POST_MORTEM_MODE=n
CONFIG_SEGGER_RTT_BUFFER_SIZE_UP=4096
```

## boards/qemu_x86.conf
```kconfig
CONFIG_GPIO=y
CONFIG_GPIO_EMUL=y # emulate the GPIO driver
```

## src/main.cpp
```c
/**
 ******************************************************************************
 * @file        : main.cpp
 * @brief       : Car System with Monotonic Rate Scheduling
 * @author      : Martin Tavernier <martin.tavernier@hevs.ch>
 * @date        : 05.03.2026
 ******************************************************************************
 * @copyright   : Copyright (c) 2026
 *                HEVS
 * @attention   : SPDX-License-Identifier: Apache-2.0
 ******************************************************************************
 * @details
 * Multi-tasking program using Monotonic Rate Scheduling
 ******************************************************************************
 */

// zephyr
#include <zephyr/kernel.h>

// car_system
#include "car_system.hpp"

int main(void) {
    car_system::CarSystem carSystem;
    carSystem.start();

    k_sleep(K_FOREVER);

    return 0;
}
```

## src/car_system.cpp
```c
// Copyright 2025 Haute école d'ingénierie et d'architecture de Fribourg
//
// Licensed under the Apache License, Version 2.0 (the "License");
// you may not use this file except in compliance with the License.
// You may obtain a copy of the License at
//
//     http://www.apache.org/licenses/LICENSE-2.0
//
// Unless required by applicable law or agreed to in writing, software
// distributed under the License is distributed on an "AS IS" BASIS,
// WITHOUT WARRANTIES OR CONDITIONS OF ANY KIND, either express or implied.
// See the License for the specific language governing permissions and
// limitations under the License.

/****************************************************************************
 * @file car_system.cpp
 * @author Serge Ayer <serge.ayer@hefr.ch>
 *
 * @brief Car System implementation file
 *
 * @date 2025-07-01
 * @version 1.0.0
 ***************************************************************************/

// zpp_lib
#include "zpp_include/this_thread.hpp"
#include "zpp_include/time.hpp"

// car_system
#include "car_system.hpp"

#ifdef CONFIG_SEGGER_SYSTEMVIEW
#include "SEGGER_SYSVIEW.h"
#endif  // CONFIG_SEGGER_SYSTEMVIEW

namespace car_system {

namespace {

constexpr const char* kEngineName           = "Engine";
constexpr const char* kDisplayName          = "Display";
constexpr const char* kTireName             = "Tire";
constexpr const char* kRainName             = "Rain";
constexpr const char* kDeferrableServerName = "DefServer";

}  // namespace

CarSystem::CarSystem() {
    _taskMethods[0] = [this]() { task_method(0); };
    _taskMethods[1] = [this]() { task_method(1); };
    _taskMethods[2] = [this]() { task_method(2); };
    _taskMethods[3] = [this]() { task_method(3); };

#if CONFIG_PHASE_B
    _taskMethods[4] = [this]() {
        _deferrableServer.start(
            _barrier, _deferrableServerInfo, _sporadicTaskGenerator);
    };
#endif  // CONFIG_PHASE_B

    _threads[0] = std::make_unique<zpp_lib::Thread>(
        zpp_lib::PreemptableThreadPriority::PriorityRealtime, kEngineName);
    _threads[1] = std::make_unique<zpp_lib::Thread>(
        zpp_lib::PreemptableThreadPriority::PriorityHigh, kDisplayName);
    _threads[2] = std::make_unique<zpp_lib::Thread>(
        zpp_lib::PreemptableThreadPriority::PriorityAboveNormal, kTireName);
    _threads[3] = std::make_unique<zpp_lib::Thread>(
        zpp_lib::PreemptableThreadPriority::PriorityNormal, kRainName);

#if CONFIG_PHASE_B
    _threads[4] = std::make_unique<zpp_lib::Thread>(
        zpp_lib::PreemptableThreadPriority::PriorityBelowNormal,
        kDeferrableServerName);
#endif  // CONFIG_PHASE_B
}

void CarSystem::start() {
    using std::literals::chrono_literals::operator""s;
    zpp_lib::ThisThread::sleep_for(9s);
    for (size_t i = 0; i < kNumberOfTasks; i++) {
        auto res = _threads[i]->start(_taskMethods[i]);
        if (!res) {
            return;
        }
    }

    for (size_t i = 0; i < kNumberOfTasks; i++) {
        auto result = _startSemaphore.release();
    }

#if CONFIG_PHASE_B
    _sporadicTaskGenerator.start(_barrier);
#endif  // CONFIG_PHASE_B
}

void CarSystem::stop() { _stopFlag.store(true); }

void CarSystem::task_method(size_t taskIndex) {
    auto result = _startSemaphore.acquire();

    auto startTime =
        std::chrono::duration_cast<std::chrono::milliseconds>(_barrier.wait());

    auto nextPeriodStart = startTime;

    while (!_stopFlag.load()) {
#ifdef CONFIG_SEGGER_SYSTEMVIEW
        SEGGER_SYSVIEW_MarkStart(taskIndex);
#endif  // CONFIG_SEGGER_SYSTEMVIEW

        zpp_lib::ThisThread::busy_wait(
            _periodicTaskInfos[taskIndex]._computationTime);

#ifdef CONFIG_SEGGER_SYSTEMVIEW
        SEGGER_SYSVIEW_MarkStop(taskIndex);
#endif  // CONFIG_SEGGER_SYSTEMVIEW

        nextPeriodStart += _periodicTaskInfos[taskIndex]._period;
        zpp_lib::ThisThread::sleep_until(nextPeriodStart);
    }
}

}  // namespace car_system
```

## src/car_system.hpp
```c
// Copyright 2025 Haute école d'ingénierie et d'architecture de Fribourg
//
// Licensed under the Apache License, Version 2.0 (the "License");
// you may not use this file except in compliance with the License.
// You may obtain a copy of the License at
//
//     http://www.apache.org/licenses/LICENSE-2.0
//
// Unless required by applicable law or agreed to in writing, software
// distributed under the License is distributed on an "AS IS" BASIS,
// WITHOUT WARRANTIES OR CONDITIONS OF ANY KIND, either express or implied.
// See the License for the specific language governing permissions and
// limitations under the License.

/****************************************************************************
 * @file car_system.hpp
 * @author Serge Ayer <serge.ayer@hefr.ch>
 *
 * @brief Car System header file
 *
 * @date 2025-07-01
 * @version 1.0.0
 ***************************************************************************/

#pragma once

// stl
#include <atomic>
#include <chrono>
#include <functional>
#include <memory>

// zpp_lib
#include "zpp_include/barrier.hpp"
#include "zpp_include/non_copyable.hpp"
#include "zpp_include/semaphore.hpp"
#include "zpp_include/thread.hpp"

#if CONFIG_PHASE_B
#include "deferrable_server.hpp"
#include "periodic_task_info.hpp"
#include "sporadic_task_generator.hpp"
#endif  // CONFIG_PHASE_B

namespace car_system {

class CarSystem {
   public:
    CarSystem();

    void start();
    void stop();

   private:
    void task_method(size_t taskIndex);

    static constexpr size_t kNumberOfPeriodicTasks = 4;
    static constexpr size_t kNumberOfTasks =
        kNumberOfPeriodicTasks + 1;  // +1 for DeferrableServer

    std::unique_ptr<zpp_lib::Thread> _threads[kNumberOfTasks];
    std::function<void()> _taskMethods[kNumberOfTasks];

#if CONFIG_PHASE_B
    zpp_lib::Barrier _barrier{kNumberOfTasks + 1};
    zpp_lib::Semaphore _startSemaphore{0, kNumberOfTasks};
#else
    zpp_lib::Barrier _barrier{kNumberOfPeriodicTasks};
    zpp_lib::Semaphore _startSemaphore{0, kNumberOfPeriodicTasks};
#endif

    std::atomic<bool> _stopFlag{false};

    PeriodicTaskInfo _periodicTaskInfos[kNumberOfPeriodicTasks] = {
        {std::chrono::milliseconds(10),
         std::chrono::milliseconds(50),
         std::chrono::milliseconds(50),
         zpp_lib::PreemptableThreadPriority::PriorityRealtime,
         "Engine"},
        {std::chrono::milliseconds(15),
         std::chrono::milliseconds(125),
         std::chrono::milliseconds(125),
         zpp_lib::PreemptableThreadPriority::PriorityHigh,
         "Display"},
        {std::chrono::milliseconds(10),
         std::chrono::milliseconds(200),
         std::chrono::milliseconds(200),
         zpp_lib::PreemptableThreadPriority::PriorityAboveNormal,
         "Tire"},
        {std::chrono::milliseconds(25),
         std::chrono::milliseconds(250),
         std::chrono::milliseconds(250),
         zpp_lib::PreemptableThreadPriority::PriorityNormal,
         "Rain"}};

#if CONFIG_PHASE_B
    AperiodicTaskInfo _aperiodicTaskInfos[2] = {
        {AperiodicTaskType::PresenceDetection, std::chrono::milliseconds(50)},
        {AperiodicTaskType::SearchPeripheralDevices,
         std::chrono::milliseconds(200)}};

    SporadicTaskGenerator _sporadicTaskGenerator;

    PeriodicTaskInfo _deferrableServerInfo = {
        std::chrono::milliseconds(250),
        std::chrono::milliseconds(1000),
        std::chrono::milliseconds(1000),
        zpp_lib::PreemptableThreadPriority::PriorityBelowNormal,
        "DeferrableServer"};

    DeferrableServer _deferrableServer;
#endif  // CONFIG_PHASE_B
};

}  // namespace car_system
```

## src/deferrable_server.cpp
```c
// Copyright 2025 Haute école d'ingénierie et d'architecture de Fribourg
//
// Licensed under the Apache License, Version 2.0 (the "License");
// you may not use this file except in compliance with the License.
// You may obtain a copy of the License at
//
//     http://www.apache.org/licenses/LICENSE-2.0
//
// Unless required by applicable law or agreed to in writing, software
// distributed under the License is distributed on an "AS IS" BASIS,
// WITHOUT WARRANTIES OR CONDITIONS OF ANY KIND, either express or implied.
// See the License for the specific language governing permissions and
// limitations under the License.

/****************************************************************************
 * @file deferrable_server.cpp
 * @author Serge Ayer <serge.ayer@hefr.ch>
 *
 * @brief DeferrableServer implementation
 *
 * @date 2025-07-01
 * @version 1.0.0
 ***************************************************************************/

#if CONFIG_PHASE_B

#include "deferrable_server.hpp"

#include "zpp_include/this_thread.hpp"
#include "zpp_include/time.hpp"

#ifdef CONFIG_SEGGER_SYSTEMVIEW
#include "SEGGER_SYSVIEW.h"
#endif  // CONFIG_SEGGER_SYSTEMVIEW

namespace car_system {

void DeferrableServer::start(zpp_lib::Barrier& barrier,
                             const PeriodicTaskInfo& taskInfo,
                             SporadicTaskGenerator& taskGenerator) {
    auto startTime =
        std::chrono::duration_cast<std::chrono::milliseconds>(barrier.wait());

    using std::literals::chrono_literals::operator""ms;
    using std::literals::chrono_literals::operator""s;

    std::chrono::milliseconds serverPeriod   = taskInfo._period;
    std::chrono::milliseconds serverCapacity = taskInfo._computationTime;
    static constexpr auto timeOut            = 500ms;

    auto nextPeriodStart = startTime;

    while (!_stopFlag.load()) {
        std::chrono::milliseconds remainingBudget = serverCapacity;

#ifdef CONFIG_SEGGER_SYSTEMVIEW
        SEGGER_SYSVIEW_MarkStart(4);
#endif  // CONFIG_SEGGER_SYSTEMVIEW

        while (remainingBudget > std::chrono::milliseconds(0) &&
               !_stopFlag.load()) {
            AperiodicTaskInfo taskInfo;
            auto boolRes = taskGenerator.get_sporadic_task(taskInfo, timeOut);

            if (boolRes &&
                taskInfo.computationTime > std::chrono::milliseconds(0)) {
                if (taskInfo.computationTime <= remainingBudget) {
                    zpp_lib::ThisThread::busy_wait(taskInfo.computationTime);
                    remainingBudget -= taskInfo.computationTime;
                } else {
                    taskGenerator.resubmit_sporadic_task(taskInfo);
                }
            }
        }

#ifdef CONFIG_SEGGER_SYSTEMVIEW
        SEGGER_SYSVIEW_MarkStop(4);
#endif  // CONFIG_SEGGER_SYSTEMVIEW

        nextPeriodStart += serverPeriod;
        zpp_lib::ThisThread::sleep_until(nextPeriodStart);
    }
}

void DeferrableServer::stop() { _stopFlag = true; }

}  // namespace car_system

#endif  // CONFIG_PHASE_B
```

## src/sporadic_task_generator.cpp
```c
// Copyright 2025 Haute école d'ingénierie et d'architecture de Fribourg
//
// Licensed under the Apache License, Version 2.0 (the "License");
// you may not use this file except in compliance with the License.
// You may obtain a copy of the License at
//
//     http://www.apache.org/licenses/LICENSE-2.0
//
// Unless required by applicable law or agreed to in writing, software
// distributed under the License is distributed on an "AS IS" BASIS,
// WITHOUT WARRANTIES OR CONDITIONS OF ANY KIND, either express or implied.
// See the License for the specific language governing permissions and
// limitations under the License.

/****************************************************************************
 * @file car_system.cpp
 * @author Serge Ayer <serge.ayer@hefr.ch>
 *
 * @brief SporadicClassGenerator implementation
 *
 * @date 2025-07-01
 * @version 1.0.0
 ***************************************************************************/

#if CONFIG_PHASE_B

#include "sporadic_task_generator.hpp"

// zephyr
#include <zephyr/logging/log.h>
#if CONFIG_USERSPACE
#include <zephyr/app_memory/app_memdomain.h>
#endif  // CONFIG_USERSPACE
#if CONFIG_SEGGER_SYSTEMVIEW
#include "SEGGER_SYSVIEW.h"
#endif  // CONFIG_SEGGER_SYSTEMVIEW

#if CONFIG_USERSPACE
extern struct k_mem_partition app_partition;
#define APP_DATA K_APP_DMEM(app_partition)
#endif  // CONFIG_USERSPACE

// stl
#include <chrono>

LOG_MODULE_DECLARE(car_system, CONFIG_APP_LOG_LEVEL);

namespace car_system {

#if CONFIG_USERSPACE
APP_DATA char gMsgqBuffer[sizeof(std::chrono::milliseconds) *
                          SporadicTaskGenerator::MESSAGE_QUEUE_SIZE] = {0};

SporadicTaskGenerator::SporadicTaskGenerator() : _messageQueue(gMsgqBuffer) {}
#endif  // CONFIG_USERSSPACE

void SporadicTaskGenerator::start(zpp_lib::Barrier& barrier) {
    // Wait that all threads are ready to start
    std::chrono::milliseconds startExecutionTime =
        std::chrono::duration_cast<std::chrono::milliseconds>(barrier.wait());
    LOG_DBG("SporadicTaskGenerator Thread starting at time %lld ms",
            startExecutionTime.count());

    using std::literals::chrono_literals::operator""ms;
    using std::literals::chrono_literals::operator""s;
    static const AperiodicTaskInfo AperiodicTasks[] = {
        {AperiodicTaskType::PresenceDetection, 50ms},
        {AperiodicTaskType::SearchPeripheralDevices, 200ms},
        {AperiodicTaskType::PresenceDetection, 50ms},
        {AperiodicTaskType::SearchPeripheralDevices, 200ms}};
    static const std::chrono::milliseconds AperiodicArrivalTimes[] = {
        60ms, 300ms, 630ms, 900ms};
    static const uint32_t NbrOfSporadicRequestsPerMajorCycle =
        sizeof(AperiodicArrivalTimes) / sizeof(AperiodicArrivalTimes[0]);

    uint32_t cycleIndex                      = 0;
    static constexpr auto majorCycleDuration = 1000ms;
    while (!_stopFlag) {
        uint32_t sporadicIndexInMajorCycle = 0;

        // generate aperiodic requests for this major cycle
        while (sporadicIndexInMajorCycle < NbrOfSporadicRequestsPerMajorCycle) {
            // wait for the next request to be generated
            auto nextTime = AperiodicArrivalTimes[sporadicIndexInMajorCycle] +
                            startExecutionTime +
                            (cycleIndex * majorCycleDuration);
            LOG_DBG("SporadicTaskGenerator thread sleeping until %lld ms",
                    nextTime.count());

            zpp_lib::ThisThread::sleep_until(nextTime);

            static constexpr auto timeOut     = 1s;
            zpp_lib::ZephyrBoolResult boolRes = _messageQueue.try_put_for(
                timeOut, AperiodicTasks[sporadicIndexInMajorCycle]);
            __ASSERT(!boolRes.has_error(),
                     "Got an error from try_put_for: %d",
                     static_cast<int>(boolRes.error()));
            if (!boolRes) {
                LOG_ERR("Could not put event to messageQueue");
            }

            sporadicIndexInMajorCycle++;
        }

        // move to next major cycle
        cycleIndex++;
    }
}

void SporadicTaskGenerator::stop() { _stopFlag = true; }

zpp_lib::ZephyrBoolResult SporadicTaskGenerator::get_sporadic_task(
    AperiodicTaskInfo& taskInfo, const std::chrono::milliseconds& timeOut) {
    zpp_lib::ZephyrBoolResult boolRes =
        _messageQueue.try_get_for(timeOut, taskInfo);
    __ASSERT(!boolRes.has_error(),
             "Got an error from try_get_for: %d",
             static_cast<int>(boolRes.error()));
    return boolRes;
}

zpp_lib::ZephyrBoolResult SporadicTaskGenerator::resubmit_sporadic_task(
    const AperiodicTaskInfo& taskInfo) {
    using std::literals::chrono_literals::operator""s;
    static constexpr auto timeOut = 1s;
    zpp_lib::ZephyrBoolResult boolRes =
        _messageQueue.try_put_for(timeOut, taskInfo);
    __ASSERT(!boolRes.has_error(),
             "Got an error from try_put_for: %d",
             static_cast<int>(boolRes.error()));
    if (!boolRes) {
        LOG_ERR("Could not put event to messageQueue");
    }
    return boolRes;
}

#if CONFIG_USERSPACE
void SporadicTaskGenerator::grant_access(k_tid_t tid) {
    _messageQueue.grant_access(tid);
}

#endif  // CONFIG_USERSPACE

}  // namespace car_system

#endif  // CONFIG_PHASE_B
```

## src/sporadic_task_generator.hpp
```c
// Copyright 2025 Haute école d'ingénierie et d'architecture de Fribourg
//
// Licensed under the Apache License, Version 2.0 (the "License");
// you may not use this file except in compliance with the License.
// You may obtain a copy of the License at
//
//     http://www.apache.org/licenses/LICENSE-2.0
//
// Unless required by applicable law or agreed to in writing, software
// distributed under the License is distributed on an "AS IS" BASIS,
// WITHOUT WARRANTIES OR CONDITIONS OF ANY KIND, either express or implied.
// See the License for the specific language governing permissions and
// limitations under the License.

/****************************************************************************
 * @file task_recorder.hpp
 * @author Serge Ayer <serge.ayer@hefr.ch>
 *
 * @brief SporadicTaskGenerator class declaration
 *
 * @date 2025-07-01
 * @version 1.0.0
 ***************************************************************************/

#pragma once

#if CONFIG_PHASE_B

// stl
#include <atomic>

// zpp_lib
#include "zpp_include/barrier.hpp"
#include "zpp_include/message_queue.hpp"
#include "zpp_include/non_copyable.hpp"
#include "zpp_include/zephyr_result.hpp"

namespace car_system {

enum class AperiodicTaskType { PresenceDetection, SearchPeripheralDevices };

struct AperiodicTaskInfo {
    AperiodicTaskType type;
    std::chrono::milliseconds computationTime;
};

class SporadicTaskGenerator
    : private zpp_lib::NonCopyable<SporadicTaskGenerator> {
   public:
    // constructor
#if CONFIG_USERSPACE
    SporadicTaskGenerator();
#else   // CONFIG_USERSPACE
    SporadicTaskGenerator() = default;
#endif  // CONFIG_USERSPACE

    // destructor
    ~SporadicTaskGenerator() = default;

    // method called from CarSystem::start() for starting generation of sporadic
    // events
    void start(zpp_lib::Barrier& barrier);

    // method called for stopping the generator
    void stop();

    // method called to obtain a task, if existing. If a sporadic task exists,
    // then the method returns true with the task info initialized.
    // If no sporadic task exists, then the method returns false.
    // In case of error, the error is returned using ZephyrBoolResult.
    zpp_lib::ZephyrBoolResult get_sporadic_task(
        AperiodicTaskInfo& taskInfo, const std::chrono::milliseconds& timeOut);

    // method called to resubmit a task that could not be executed
    zpp_lib::ZephyrBoolResult resubmit_sporadic_task(
        const AperiodicTaskInfo& taskInfo);

#if CONFIG_USERSPACE
    void grant_access(k_tid_t tid);
#endif  // CONFIG_USERSPACE

    // constant to instantiate the templated zpp_lib::MessageQueue attribute
    static constexpr uint8_t MESSAGE_QUEUE_SIZE = 10;

   private:
    // stop flag, used for stopping each task (set in stop())
    volatile std::atomic<bool> _stopFlag = false;

    zpp_lib::MessageQueue<AperiodicTaskInfo, MESSAGE_QUEUE_SIZE> _messageQueue;
};

}  // namespace car_system

#endif  // CONFIG_PHASE_B
```
