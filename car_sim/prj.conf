## CMakeLists.txt
```
cmake_minimum_required(VERSION 3.20.0)
find_package(Zephyr REQUIRED HINTS $ENV{ZEPHYR_BASE})

project(
    CarSystem
    VERSION 0.1
    DESCRIPTION "CPP Car system application."
    LANGUAGES C CXX
)

target_sources(
    app
    PRIVATE
    src/main.cpp
    src/car_system.cpp
)
```

## prj.conf
```kconfig
# C++ support
CONFIG_CPP=y
CONFIG_REQUIRES_FULL_LIBCPP=y
CONFIG_STD_CPP17=y
# use zpp_lib
CONFIG_USE_ZPP_LIB=y

# Logging disabled for performance
CONFIG_LOG=n
CONFIG_BOOT_BANNER=n

# Thread configuration
CONFIG_ZPP_THREAD_POOL_SIZE=8
CONFIG_MAIN_STACK_SIZE=4096
CONFIG_TIMESLICING=n
CONFIG_THREAD_NAME=y

# SEGGER SystemView (for nRF board)
CONFIG_TRACING=y
CONFIG_SEGGER_SYSTEMVIEW=y
CONFIG_SEGGER_SYSTEMVIEW_BOOT_ENABLE=y
CONFIG_SEGGER_SYSVIEW_POST_MORTEM_MODE=n
CONFIG_SEGGER_RTT_BUFFER_SIZE_UP=4096
```

## src/car_system.cpp
```c
// Copyright 2025 Haute école d'ingénierie et d'architecture de Fribourg
//
// Licensed under the Apache License, Version 2.0 (the "License");
// you may not use this file except in compliance with the License.
// You may obtain a copy of the License at
//
//     http://www.apache.org/licenses/LICENSE-2.0
//
// Unless required by applicable law or agreed to in writing, software
// distributed under the License is distributed on an "AS IS" BASIS,
// WITHOUT WARRANTIES OR CONDITIONS OF ANY KIND, either express or implied.
// See the License for the specific language governing permissions and
// limitations under the License.

/****************************************************************************
 * @file car_system.cpp
 * @author Serge Ayer <serge.ayer@hefr.ch>
 *
 * @brief Car System implementation file
 *
 * @date 2025-07-01
 * @version 1.0.0
 ***************************************************************************/

// zpp_lib
#include "zpp_include/this_thread.hpp"
#include "zpp_include/time.hpp"

// car_system
#include "car_system.hpp"

#ifdef CONFIG_SEGGER_SYSTEMVIEW
#include "SEGGER_SYSVIEW.h"
#endif  // CONFIG_SEGGER_SYSTEMVIEW

namespace car_system {

namespace {

constexpr const char* kEngineName  = "Engine";
constexpr const char* kDisplayName = "Display";
constexpr const char* kTireName    = "Tire";
constexpr const char* kRainName    = "Rain";

}  // namespace

CarSystem::CarSystem() {
    _taskMethods[0] = [this]() { task_method(0); };
    _taskMethods[1] = [this]() { task_method(1); };
    _taskMethods[2] = [this]() { task_method(2); };
    _taskMethods[3] = [this]() { task_method(3); };

    _threads[0] = std::make_unique<zpp_lib::Thread>(
        zpp_lib::PreemptableThreadPriority::PriorityRealtime, kEngineName);
    _threads[1] = std::make_unique<zpp_lib::Thread>(
        zpp_lib::PreemptableThreadPriority::PriorityHigh, kDisplayName);
    _threads[2] = std::make_unique<zpp_lib::Thread>(
        zpp_lib::PreemptableThreadPriority::PriorityAboveNormal, kTireName);
    _threads[3] = std::make_unique<zpp_lib::Thread>(
        zpp_lib::PreemptableThreadPriority::PriorityNormal, kRainName);
}

void CarSystem::start() {
    using std::literals::chrono_literals::operator""s;
    zpp_lib::ThisThread::sleep_for(9s);
    for (size_t i = 0; i < kNumberOfTasks; i++) {
        auto res = _threads[i]->start(_taskMethods[i]);
        if (!res) {
            return;
        }
    }

    for (size_t i = 0; i < kNumberOfTasks; i++) {
        auto result = _startSemaphore.release();
    }
}

void CarSystem::stop() { _stopFlag.store(true); }

void CarSystem::task_method(size_t taskIndex) {
    auto result = _startSemaphore.acquire();

    _barrier.wait();

    auto nextPeriodStart = zpp_lib::Time::get_uptime();

    while (!_stopFlag.load()) {
#ifdef CONFIG_SEGGER_SYSTEMVIEW
        SEGGER_SYSVIEW_MarkStart(taskIndex);
#endif  // CONFIG_SEGGER_SYSTEMVIEW

        zpp_lib::ThisThread::busy_wait(
            _periodicTaskInfos[taskIndex]._computationTime);

#ifdef CONFIG_SEGGER_SYSTEMVIEW
        SEGGER_SYSVIEW_MarkStop(taskIndex);
#endif  // CONFIG_SEGGER_SYSTEMVIEW

        nextPeriodStart += _periodicTaskInfos[taskIndex]._period;
        zpp_lib::ThisThread::sleep_until(nextPeriodStart);
    }
}

}  // namespace car_system
```

## src/car_system.hpp
```c
// Copyright 2025 Haute école d'ingénierie et d'architecture de Fribourg
//
// Licensed under the Apache License, Version 2.0 (the "License");
// you may not use this file except in compliance with the License.
// You may obtain a copy of the License at
//
//     http://www.apache.org/licenses/LICENSE-2.0
//
// Unless required by applicable law or agreed to in writing, software
// distributed under the License is distributed on an "AS IS" BASIS,
// WITHOUT WARRANTIES OR CONDITIONS OF ANY KIND, either express or implied.
// See the License for the specific language governing permissions and
// limitations under the License.

/****************************************************************************
 * @file car_system.hpp
 * @author Serge Ayer <serge.ayer@hefr.ch>
 *
 * @brief Car System header file
 *
 * @date 2025-07-01
 * @version 1.0.0
 ***************************************************************************/

#pragma once

// stl
#include <atomic>
#include <chrono>
#include <functional>
#include <memory>

// zpp_lib
#include "periodic_task_info.hpp"
#include "zpp_include/barrier.hpp"
#include "zpp_include/non_copyable.hpp"
#include "zpp_include/semaphore.hpp"
#include "zpp_include/thread.hpp"

namespace car_system {

class CarSystem {
 public:
    CarSystem();

    void start();
    void stop();

 private:
    void task_method(size_t taskIndex);

    static constexpr size_t kNumberOfPeriodicTasks = 4;
    static constexpr size_t kNumberOfTasks =
        kNumberOfPeriodicTasks;  // +1 for DeferrableServer

    std::unique_ptr<zpp_lib::Thread> _threads[kNumberOfTasks];
    std::function<void()> _taskMethods[kNumberOfTasks];

    zpp_lib::Barrier _barrier{kNumberOfPeriodicTasks};
    zpp_lib::Semaphore _startSemaphore{0, kNumberOfPeriodicTasks};

    std::atomic<bool> _stopFlag{false};

    PeriodicTaskInfo _periodicTaskInfos[kNumberOfPeriodicTasks] = {
        {std::chrono::milliseconds(10),
         std::chrono::milliseconds(50),
         zpp_lib::PreemptableThreadPriority::PriorityRealtime,
         "Engine"},
        {std::chrono::milliseconds(15),
         std::chrono::milliseconds(125),
         zpp_lib::PreemptableThreadPriority::PriorityHigh,
         "Display"},
        {std::chrono::milliseconds(10),
         std::chrono::milliseconds(200),
         zpp_lib::PreemptableThreadPriority::PriorityAboveNormal,
         "Tire"},
        {std::chrono::milliseconds(25),
         std::chrono::milliseconds(250),
         zpp_lib::PreemptableThreadPriority::PriorityNormal,
         "Rain"}};
};

}  // namespace car_system
```

## src/periodic_task_info.hpp
```c
// Copyright 2025 Haute école d'ingénierie et d'architecture de Fribourg
//
// Licensed under the Apache License, Version 2.0 (the "License");
// you may not use this file except in compliance with the License.
// You may obtain a copy of the License at
//
//     http://www.apache.org/licenses/LICENSE-2.0
//
// Unless required by applicable law or agreed to in writing, software
// distributed under the License is distributed on an "AS IS" BASIS,
// WITHOUT WARRANTIES OR CONDITIONS OF ANY KIND, either express or implied.
// See the License for the specific language governing permissions and
// limitations under the License.

/****************************************************************************
 * @file periodic_task_info.hpp
 * @author Serge Ayer <serge.ayer@hefr.ch>
 *
 * @brief Periodic Task Info definition
 *
 * @date 2025-07-01
 * @version 1.0.0
 ***************************************************************************/

#pragma once

// std
#include <chrono>

// zpp_lib
#include "zpp_include/mutex.hpp"
#include "zpp_include/types.hpp"

namespace car_system {

struct PeriodicTaskInfo {
    std::chrono::milliseconds _computationTime;
    std::chrono::milliseconds _period;
    zpp_lib::PreemptableThreadPriority _priority;
    const char* _szTaskName;
};

}  // namespace car_system
```
